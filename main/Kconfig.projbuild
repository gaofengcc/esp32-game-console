## main/Kconfig.projbuild
```kconfig
menu "游戏机 WiFi 与诊断配置"

config USER_WIFI_SSID
    string "WiFi SSID"
    default ""
    help
      编译期配置的 WiFi STA 网络名称，仅用于测试阶段自动连接。

      WiFi 凭据属于敏感信息，只能放在本地 sdkconfig 或
      sdkconfig.defaults.local（均已加入 gitignore），禁止提交到仓库。

config USER_WIFI_PASSWORD
    string "WiFi 密码"
    default ""
    help
      编译期配置的 WiFi STA 密码，仅用于测试阶段自动连接。

      WiFi 凭据属于敏感信息，只能放在本地 sdkconfig 或
      sdkconfig.defaults.local（均已加入 gitignore），禁止提交到仓库。

config GAME_CONSOLE_ENABLE_WIFI
    bool "启用游戏机 WiFi"
    default y
    help
      启用后，固件以 STA 模式使用上面的编译期凭据连接 WiFi。
      关闭后完全不初始化或连接 WiFi。

config GAME_CONSOLE_DIAG_PORT
    int "诊断服务端口"
    range 1 65535
    default 8080
    help
      局域网诊断服务使用的 HTTP 端口。

config GAME_CONSOLE_DIAG_TOKEN
    string "诊断服务 Bearer Token"
    default ""
    help
      诊断服务鉴权令牌。留空时由固件启动时随机生成并打印到串口。
      令牌属于敏感信息，只能放在本地 sdkconfig 或
      sdkconfig.defaults.local（均已加入 gitignore），禁止提交到仓库。

endmenu
```

## sdkconfig.defaults
```kconfig
CONFIG_IDF_TARGET_ESP32S3=y
CONFIG_ESPTOOLPY_FLASHSIZE_16MB=y
CONFIG_ESPTOOLPY_FLASHSIZE="16MB"

CONFIG_PARTITION_TABLE_CUSTOM=y
CONFIG_PARTITION_TABLE_CUSTOM_FILENAME="partitions_game.csv"
CONFIG_PARTITION_TABLE_FILENAME="partitions_game.csv"

CONFIG_SPIRAM=y
CONFIG_SPIRAM_MODE_OCT=y
CONFIG_SPIRAM_USE_MALLOC=y
CONFIG_SPIRAM_MALLOC_ALWAYSINTERNAL=16384

CONFIG_FREERTOS_HZ=1000
CONFIG_ESP_DEFAULT_CPU_FREQ_MHZ=240

# 使用 UART0 GPIO43/44 输出日志，保持与硬件接线一致。
CONFIG_ESP_CONSOLE_UART_CUSTOM=y
CONFIG_ESP_CONSOLE_UART_CUSTOM_NUM_0=y
CONFIG_ESP_CONSOLE_UART_TX_GPIO=43
CONFIG_ESP_CONSOLE_UART_RX_GPIO=44
CONFIG_ESP_CONSOLE_UART_BAUDRATE=921600
CONFIG_ESPTOOLPY_MONITOR_BAUD=921600

# LVGL 使用仓库内 lv_conf.h，不启用示例和演示。
CONFIG_LV_CONF_SKIP=y
CONFIG_LV_BUILD_EXAMPLES=n
CONFIG_LV_BUILD_DEMOS=n
CONFIG_LV_USE_QRCODE=n
CONFIG_LV_USE_SNAPSHOT=y
CONFIG_LVGL_SCREENSHOT_ENABLE=y

# 双 OTA 启用回滚保护；ota_update 会在启动自检后确认新固件。
CONFIG_BOOTLOADER_APP_ROLLBACK_ENABLE=y

# 开发期保留较大的应用空间；WiFi 凭据只放本地 sdkconfig。
CONFIG_COMPILER_OPTIMIZATION_SIZE=y
```
